## Kconfig.projbuild
```kconfig
menu "CW-WW LED Controller Configuration"

    menu "Hardware Pin Configuration"
        config LED_CW_GPIO
            int "Cool White (CW) PWM GPIO Pin"
            default 0
            help
                GPIO pin connected to the Cool White LED MOSFET driver.

        config LED_WW_GPIO
            int "Warm White (WW) PWM GPIO Pin"
            default 1
            help
                GPIO pin connected to the Warm White LED MOSFET driver.

        config STATUS_LED_GPIO
            int "Status Indicator LED GPIO Pin"
            default 8
            help
                GPIO pin connected to the status indicator LED.

        config STATUS_LED_ACTIVE_LEVEL
            int "Status LED Active Level (0 for Active-Low, 1 for Active-High)"
            range 0 1
            default 0
            help
                Logic level that turns the status LED ON. Standard devboards usually have active-low LEDs.

        config BUTTON_GPIO
            int "Push Button GPIO Pin"
            default 9
            help
                GPIO pin connected to the control push button (default BOOT pin on ESP32-C6).

        config FACTORY_RESET_HOLD_TIME_SEC
            int "Factory Reset Button Hold Time (seconds)"
            default 10
            help
                Number of seconds the button must be held down to trigger a factory reset.

        config PWM_FREQUENCY_HZ
            int "PWM Frequency in Hz"
            default 22000
            help
                PWM frequency for LEDC driver (default 22000 Hz, inaudible and flicker-free).
    endmenu

    menu "Custom MAC Address Configuration"
        config CUSTOM_MAC_ENABLE
            bool "Enable Custom Wi-Fi MAC Address"
            default y
            help
                When enabled, the firmware overrides the factory eFuse base MAC address
                using either the static MAC configured below or one stored in NVS under key 'custom_mac'.

        config CUSTOM_MAC_ADDRESS
            string "Default Static MAC Address"
            default "A0:B1:C2:D3:E4:F5"
            depends on CUSTOM_MAC_ENABLE
            help
                Custom Base/Wi-Fi MAC address formatted as XX:XX:XX:XX:XX:XX.
                Must have bit 0 of the first byte set to 0 (unicast) and bit 1 set to 1 (locally administered).
    endmenu

    menu "Color Temperature Limits"
        config MIN_COLOR_TEMP_MIREDS
            int "Minimum Color Temperature in Mireds (Coolest, e.g. 6500K = 153 Mireds)"
            default 153
            help
                Matter specification minimum mireds (1,000,000 / K). 153 corresponds to ~6535K.

        config MAX_COLOR_TEMP_MIREDS
            int "Maximum Color Temperature in Mireds (Warmest, e.g. 2700K = 370 Mireds)"
            default 370
            help
                Matter specification maximum mireds (1,000,000 / K). 370 corresponds to ~2702K.
    endmenu

endmenu
```

## main/Kconfig.projbuild
```kconfig
menu "CW-WW LED Controller Configuration"

    menu "Hardware Pin Configuration"
        config LED_CW_GPIO
            int "Cool White (CW) PWM GPIO Pin"
            range 0 31
            default 0
            help
                GPIO pin connected to the Cool White LED MOSFET driver.

        config LED_WW_GPIO
            int "Warm White (WW) PWM GPIO Pin"
            range 0 31
            default 1
            help
                GPIO pin connected to the Warm White LED MOSFET driver.

        config STATUS_LED_GPIO
            int "Status Indicator LED GPIO Pin"
            range 0 31
            default 8
            help
                GPIO pin connected to the status indicator LED.

        config STATUS_LED_ACTIVE_LEVEL
            int "Status LED Active Level (0 for Active-Low, 1 for Active-High)"
            range 0 1
            default 0
            help
                Logic level that turns the status LED ON. Standard devboards usually have active-low LEDs.

        config BUTTON_GPIO
            int "Push Button GPIO Pin"
            range 0 31
            default 9
            help
                GPIO pin connected to the control push button (default BOOT pin on ESP32-C3 / ESP32-C6).

        config FACTORY_RESET_HOLD_TIME_SEC
            int "Factory Reset Button Hold Time (seconds)"
            range 3 30
            default 10
            help
                Number of seconds the button must be held down to trigger a factory reset.

        config PWM_FREQUENCY_HZ
            int "PWM Frequency in Hz"
            range 100 40000
            default 4000
            help
                PWM frequency for LEDC driver (default 4000 Hz: IEEE 1789 flicker-free, optimal for logic-level MOSFETs).

        config LIGHT_FADE_TIME_MS
            int "Hardware LEDC Fade Transition Time (ms)"
            range 0 2000
            default 250
            help
                Hardware-accelerated transition time in milliseconds for brightness and color changes (0 for instantaneous).
    endmenu

    menu "Custom MAC Address Configuration"
        config CUSTOM_MAC_ENABLE
            bool "Enable Custom Wi-Fi MAC Address"
            default y
            help
                When enabled, the firmware overrides the factory eFuse base MAC address
                using either the static MAC configured below or one stored in NVS under key 'custom_mac'.

        config CUSTOM_MAC_ADDRESS
            string "Default Static MAC Address"
            default "A0:B1:C2:D3:E4:F5"
            depends on CUSTOM_MAC_ENABLE
            help
                Custom Base/Wi-Fi MAC address formatted as XX:XX:XX:XX:XX:XX.
                Must have bit 0 of the first byte set to 0 (unicast) and bit 1 set to 1 (locally administered).
    endmenu

    menu "Color Temperature Limits"
        config MIN_COLOR_TEMP_MIREDS
            int "Minimum Color Temperature in Mireds (Coolest / Light Blue UI, default 50 Mireds)"
            range 50 1000
            default 50
            help
                Minimum mireds exposed to Matter/Apple Home. 50-400 Mireds unlocks the full Light Blue -> White -> Orange UI wheel and maps 0-100% across CW/WW.

        config MAX_COLOR_TEMP_MIREDS
            int "Maximum Color Temperature in Mireds (Warmest / Orange UI, default 400 Mireds)"
            range 50 1000
            default 400
            help
                Maximum mireds exposed to Matter/Apple Home. 400 Mireds maps to 100% Warm White (WW).
    endmenu

endmenu
```

## sdkconfig.defaults
```kconfig
# Target
CONFIG_IDF_TARGET="esp32c3"

# Partition Table
CONFIG_PARTITION_TABLE_CUSTOM=y
CONFIG_PARTITION_TABLE_CUSTOM_FILENAME="partitions.csv"
CONFIG_PARTITION_TABLE_FILENAME="partitions.csv"
CONFIG_PARTITION_TABLE_OFFSET=0x8000
CONFIG_ESPTOOLPY_FLASHSIZE_4MB=y

# FreeRTOS
CONFIG_FREERTOS_HZ=1000

# Bluetooth & NimBLE (Required for Matter BLE Commissioning)
CONFIG_BT_ENABLED=y
CONFIG_BT_NIMBLE_ENABLED=y
CONFIG_BT_NIMBLE_NVS_PERSIST=y
CONFIG_BT_NIMBLE_MAX_CONNECTIONS=1

# Wi-Fi & LwIP
CONFIG_ESP_WIFI_STATIC_RX_BUFFER_NUM=10
CONFIG_ESP_WIFI_DYNAMIC_RX_BUFFER_NUM=32
CONFIG_ESP_WIFI_DYNAMIC_TX_BUFFER_NUM=32
CONFIG_ESP_WIFI_AMPDU_TX_ENABLED=y
CONFIG_ESP_WIFI_AMPDU_RX_ENABLED=y
CONFIG_ESP_WIFI_STA_DISCONNECTED_PM_ENABLE=n
CONFIG_LWIP_IPV6=y
CONFIG_LWIP_IPV6_AUTOCONFIG=y
CONFIG_LWIP_IPV6_NUM_ADDRESSES=8

# Matter Core & Server Configuration
CONFIG_ESP_MATTER_ENABLE_MATTER_SERVER=y
CONFIG_ENABLE_OTA_REQUESTOR=y
CONFIG_ENABLE_CHIP_SHELL=n

# Build Speed Optimizations: Disable Unused Matter Subsystems
CONFIG_ESP_MATTER_ENABLE_OPENTHREAD=n
CONFIG_BUILD_CHIP_TESTS=n
CONFIG_ENABLE_CHIP_CONTROLLER_BUILD=n
CONFIG_ESP_MATTER_CONTROLLER_ENABLE=n
CONFIG_CHIP_ENABLE_BDX_LOG_TRANSFER=n
CONFIG_CHIP_CONFIG_IM_PRETTY_PRINT=n

# Compiler Options
CONFIG_COMPILER_OPTIMIZATION_SIZE=y
CONFIG_COMPILER_OPTIMIZATION_ASSERTION_LEVEL=1

# Custom MAC Address
CONFIG_CUSTOM_MAC_ENABLE=y
CONFIG_CUSTOM_MAC_ADDRESS="1E:F6:BA:C8:10:8C"

# PWM, Color Range & Driver Reliability
CONFIG_PWM_FREQUENCY_HZ=4000
CONFIG_MIN_COLOR_TEMP_MIREDS=50
CONFIG_MAX_COLOR_TEMP_MIREDS=400

# OTA Rollback & Watchdog Reliability
CONFIG_BOOTLOADER_APP_ROLLBACK_ENABLE=y
CONFIG_ESP_TASK_WDT_PANIC=y
CONFIG_ESP_SYSTEM_PANIC_PRINT_REBOOT=y
```
